/dts-v1/;
/plugin/;

/ {
        model = "Qualcomm Technologies, Inc. MSM8953 + PMI8950 MTP";
        compatible = "qcom,msm8953-mtp", "qcom,msm8953", "qcom,mtp";
        qcom,board-id= <26 0>;
        qcom,pmic-id = <0x010016 0x010011 0x0 0x0>;
};
